## Kconfig
```kconfig
menu "GNU Go Configuration"
    config DISABLE_MONTE_CARLO
        bool "Disable Monte Carlo patterns"
        default n
    config GNUGO_STACK_SIZE
        int "Stack size"
        default 60
        range 10 80
    config USE_TCM
        bool "Use ESP TCM for certain buffers"
        default n
    config USE_ESP_RANDOM
        bool "Use esp_random"
        default y
endmenu
```
